## main/Kconfig.projbuild
```kconfig
menu "Brouwketel"

config BROUW_NEP_TEMPERATUUR
    bool "Nep-temperatuur (thuis testen zonder PT100)"
    default n
    help
        Aan: de ESP leest de PT100 niet uit, maar doet alsof de ketel opwarmt.
        Zolang het water kouder is dan het doel van het scherm stijgt de
        temperatuur 1 graad per seconde (verwarming 100%), anders zakt ze
        langzaam (verwarming 0%). Alleen om thuis te testen: in het lokaal
        moet dit UIT staan.

endmenu
```
